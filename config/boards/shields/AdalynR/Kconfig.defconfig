## config/boards/shields/AdalynR/Kconfig.defconfig
```kconfig
if SHIELD_MY_BOARD

config ZMK_KEYBOARD_NAME
    default "AdalynR"
    
config ZMK_USB
    default y

endif
```

## config/west.yml
```yaml
manifest:
  remotes:
    - name: zmkfirmware
      url-base: https://github.com/zmkfirmware
    - name: Rowii
      url-base: https://github.com/LB16
  projects:
    - name: zmk
      remote: zmkfirmware
      revision: main
      import: app/west.yml
  self:
    path: config
```
